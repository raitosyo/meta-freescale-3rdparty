## conf/machine/coral-dev.conf
```bitbake
#@TYPE: Machine
#@NAME: Google Coral Dev Board
#@SOC: i.MX8MQ
#@DESCRIPTION: Machine configuration for Google Coral Dev Board
#@MAINTAINER: Ryosuke Saito <raitosyo@gmail.com>

MACHINEOVERRIDES =. "imx-boot-container:mx8:mx8m:mx8mq:"

# NOTE:
#   Use mainline bsp as default. This might be removed if future nxp bsp
#   would have supported phanbell.
MACHINEOVERRIDES =. "use-mainline-bsp:"

require conf/machine/include/imx-base.inc
require conf/machine/include/tune-cortexa53.inc

IMX_DEFAULT_BSP = "nxp"

MACHINE_FEATURES += " pci wifi bluetooth qca6174"

MACHINE_SOCARCH_FILTER_append_mx8mq = " virtual/libopenvg virtual/libgles1 virtual/libgles2 virtual/egl virtual/mesa virtual/libgl virtual/libg2d"

PREFERRED_PROVIDER_virtual/kernel ??= "linux-google"
PREFERRED_PROVIDER_virtual/kernel_use-mainline-bsp ??= "linux-google"

KERNEL_DEVICETREE = "freescale/imx8mq-phanbell.dtb"

IMX_DEFAULT_BOOTLOADER_use-nxp-bsp = "u-boot-fslc"
IMX_DEFAULT_BOOTLOADER_use-mainline-bsp = "u-boot-fslc"

UBOOT_SUFFIX = "bin"

UBOOT_CONFIG ??= "sd"
UBOOT_CONFIG[sd] = "imx8mq_phanbell_defconfig,sdcard"

SPL_BINARY = "spl/u-boot-spl.bin"

# Set DDR FIRMWARE
DDR_FIRMWARE_NAME = "\
    lpddr4_pmu_train_1d_imem.bin \
    lpddr4_pmu_train_1d_dmem.bin \
    lpddr4_pmu_train_2d_imem.bin \
    lpddr4_pmu_train_2d_dmem.bin \
"

# Set u-boot DTB
UBOOT_DTB_NAME = "imx8mq-phanbell.dtb"

# Set ATF platform name
ATF_PLATFORM = "imx8mq"
ATF_LOAD_ADDR = "0x910000"

# Extra firmware package name, that is required to build boot container for fslc bsp
IMX_EXTRA_FIRMWARE = "firmware-imx-8m"

LOADADDR = ""
UBOOT_SUFFIX = "bin"
UBOOT_MAKE_TARGET = "all"
IMX_BOOT_SEEK = "33"

OPTEE_BIN_EXT = "8mq"
TEE_LOAD_ADDR = "0xfe000000"

# Add additional firmware
MACHINE_FIRMWARE_append = " linux-firmware-ath10k"

# Use gstreamer 1.16 from meta-freescale
PREFERRED_VERSION_gstreamer1.0 ?= "1.16.imx"
PREFERRED_VERSION_gstreamer1.0-plugins-base ?= "1.16.imx"
PREFERRED_VERSION_gstreamer1.0-plugins-good ?= "1.16.imx"
PREFERRED_VERSION_gstreamer1.0-plugins-bad ?= "1.16.imx"
PREFERRED_VERSION_gstreamer1.0-libav ?= "1.16.0"
```
